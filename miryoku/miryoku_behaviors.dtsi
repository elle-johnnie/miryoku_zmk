// Copyright 2022 Manna Harbour
// https://github.com/manna-harbour/miryoku

/ {
  behaviors {
    u_mt: u_mt {
      compatible = "zmk,behavior-hold-tap";
      label = "u_mt";
      #binding-cells = <2>;
      tapping_term_ms = <U_TAPPING_TERM>;
      flavor = "tap-preferred";
      bindings = <&kp>, <&kp>;
    };
    u_lt: u_lt {
      compatible = "zmk,behavior-hold-tap";
      label = "u_lt";
      #binding-cells = <2>;
      tapping_term_ms = <U_TAPPING_TERM>;
      flavor = "tap-preferred";
      bindings = <&mo>, <&kp>;
    };
    // bst: backspace-tap {
    //   compatible = "zmk,behavior-hold-tap";
    //   label = "BSPC_TAP_SYM_HOLD";
    //   #binding-cells = <2>;
    //   flavor = "balanced";
    //   tapping-term-ms = <220>;
    //   quick-tap-ms = <170>;
    //   //require-prior-idle-ms = <100>;
    //   bindings = <&mo>, <&kp>;
    // };
  };
};
